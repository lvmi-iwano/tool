## code/kernel-3.18-trustkernel/drivers/misc/mediatek/fingerprint/Kconfig
```kconfig
config HCT_FINGERPRINT_SUPPORT
  bool "HCT_FINGERPRINT_SUPPORT"
  default n

source "drivers/misc/mediatek/fingerprint/gf3208_goodix/Kconfig"
source "drivers/misc/mediatek/fingerprint/cs15xx/Kconfig"
source "drivers/misc/mediatek/fingerprint/gfx1xm/Kconfig"
source "drivers/misc/mediatek/fingerprint/sunwave9551_fp/Kconfig"
source "drivers/misc/mediatek/fingerprint/goodix_gf5216/Kconfig"
source "drivers/misc/mediatek/fingerprint/microarray_v4.0.01/Kconfig"
source "drivers/misc/mediatek/fingerprint/sunwavecorp/Kconfig"
```

## code/kernel-3.18-trustkernel/init/tsee/Kconfig
```kconfig
# TrustKernel Secure Execution Environment Real-Time Kernel Security Configuration	  
config TRUSTKERNEL_TSEE_RTKS
	bool "TrustKernel Secure Execution Environment Real-Time Kernel Security"
	default n
	---help---
	  This enables TrustKernel TSEE Real-Time Kernel Security.

config TRUSTKERNEL_TSEE_RTKS_TZ
	bool "TrustKernel Secure Execution Environment Real-Time Kernel Security Using TrustZone"
	default n
	---help---
	  This implements TrustKernel TSEE Real-Time Kernel Security Using TrustZone.

config TRUSTKERNEL_TSEE_RTKS_VMM
	bool "TrustKernel Secure Execution Environment Real-Time Kernel Security Using VMM"
	default n
	---help---
	  This implements TrustKernel TSEE Real-Time Kernel Security Using VMM.

config TRUSTKERNEL_TSEE_RTKS_KEE
	bool "TrustKernel Secure Execution Environment Real-Time Kernel Security Using KEE"
	default n
	---help---
	  This implements TrustKernel TSEE Real-Time Kernel Security Using KEE.

config TRUSTKERNEL_TSEE_RTKS_KDP
	bool "TrustKernel Secure Execution Environment Real-Time Kernel Security with Kernel Data Protection Feature"
	default n
	---help---
	  This implements TrustKernel TSEE Real-Time Kernel Security KDP Mechanism.
```
